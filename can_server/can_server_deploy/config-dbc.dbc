VERSION ""

NS_ :

BS_:

BU_:

BO_ 259 ACQ_STATS_B: 4 Vector__XXX
 SG_ lost_count_B : 16|16@1+ (1,0) [0|65535] "ticks" Vector__XXX
 SG_ freq_reelle_Hz_B : 0|16@1+ (1,0) [0|5000] "Hz" Vector__XXX

BO_ 258 CURRENT_MEAS_B: 4 Vector__XXX
 SG_ courant_B : 0|32@1- (1,0) [-1000|1000] "A" Vector__XXX

BO_ 257 ACQ_STATS_A: 4 Vector__XXX
 SG_ lost_count_A : 16|16@1+ (1,0) [0|65535] "ticks" Vector__XXX
 SG_ freq_reelle_Hz_A : 0|16@1+ (1,0) [0|5000] "Hz" Vector__XXX

BO_ 256 CURRENT_MEAS_A: 4 Vector__XXX
 SG_ courant_A : 0|32@1- (1,0) [-1000|1000] "A" Vector__XXX

BO_ 261 TIME_SYNC: 4 Vector__XXX
 SG_ unix_timestamp_s : 0|32@1+ (1,0) [0|4294967295] "s" Vector__XXX

CM_ "

";
BA_DEF_  "NmAsrRepeatMessageTime" INT 0 0;
BA_DEF_  "NmAsrWaitBusSleepTime" INT 0 0;
BA_DEF_  "NmAsrTimeoutTime" INT 0 0;
BA_DEF_  "NmAsrCanMsgCycleTime" INT 0 0;
BA_DEF_  "NmAsrMessageCount" INT 0 256;
BA_DEF_ BU_  "GenNodSleepTime" INT 0 1000000;
BA_DEF_DEF_  "NmAsrRepeatMessageTime" 3200;
BA_DEF_DEF_  "NmAsrWaitBusSleepTime" 1500;
BA_DEF_DEF_  "NmAsrTimeoutTime" 2000;
BA_DEF_DEF_  "NmAsrCanMsgCycleTime" 640;
BA_DEF_DEF_  "NmAsrMessageCount" 64;
BA_DEF_DEF_  "GenNodSleepTime" 4000;
SIG_VALTYPE_ 258 courant_B : 1;
SIG_VALTYPE_ 256 courant_A : 1;
